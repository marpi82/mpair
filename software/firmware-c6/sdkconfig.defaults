## software/firmware-c6/sdkconfig.defaults
```kconfig
# ESP32-C6 default configuration for mpair

# Compiler options
CONFIG_COMPILER_OPTIMIZATION_SIZE=y
CONFIG_COMPILER_OPTIMIZATION_ASSERTIONS_ENABLE=y

# FreeRTOS
CONFIG_FREERTOS_HZ=1000

# Log output
CONFIG_LOG_DEFAULT_LEVEL_INFO=y
CONFIG_LOG_COLORS=y

# Application manager
CONFIG_APP_COMPILE_TIME_DATE=y

# Partition Table
CONFIG_PARTITION_TABLE_CUSTOM=y
CONFIG_PARTITION_TABLE_CUSTOM_FILENAME="partitions.csv"
CONFIG_PARTITION_TABLE_FILENAME="partitions.csv"

# Serial flasher config
CONFIG_ESPTOOLPY_FLASHSIZE_4MB=y
CONFIG_ESPTOOLPY_FLASHMODE_QIO=y
CONFIG_ESPTOOLPY_FLASHFREQ_80M=y

# ESP32C6-Specific
CONFIG_ESP32C6_DEFAULT_CPU_FREQ_160=y

# Matter/Thread support (to be configured later)
# CONFIG_OPENTHREAD_ENABLED=y
```

## software/firmware-h2/sdkconfig.defaults
```kconfig
# mpair ESP32-H2 Default Configuration

# Target chip
CONFIG_IDF_TARGET="esp32h2"

# Serial flasher config
CONFIG_ESPTOOLPY_FLASHSIZE_4MB=y
CONFIG_ESPTOOLPY_FLASHMODE_QIO=y
CONFIG_ESPTOOLPY_FLASHFREQ_48M=y

# Partition Table
CONFIG_PARTITION_TABLE_CUSTOM=y
CONFIG_PARTITION_TABLE_CUSTOM_FILENAME="partitions.csv"

# ESP32H2-Specific
CONFIG_ESP32H2_DEFAULT_CPU_FREQ_96=y

# Thread/OpenThread
CONFIG_OPENTHREAD_ENABLED=y
CONFIG_OPENTHREAD_BORDER_ROUTER=n
CONFIG_OPENTHREAD_FTD=y

# IEEE 802.15.4
CONFIG_IEEE802154_ENABLED=y

# Bluetooth (for Matter commissioning)
CONFIG_BT_ENABLED=y
CONFIG_BT_BLUEDROID_ENABLED=y

# Matter/CHIP (when using ESP-Matter)
# CONFIG_ENABLE_CHIP=y
# CONFIG_CHIP_PROJECT_CONFIG="main/project_config.h"

# FreeRTOS
CONFIG_FREERTOS_HZ=1000
CONFIG_FREERTOS_UNICORE=y

# Logging
CONFIG_LOG_DEFAULT_LEVEL_INFO=y
CONFIG_LOG_MAXIMUM_LEVEL_VERBOSE=y

# NVS
CONFIG_NVS_ENCRYPTION=n
```

## software/firmware-s3/sdkconfig.defaults
```kconfig
# mpair ESP32-S3 Default Configuration

# Target chip
CONFIG_IDF_TARGET="esp32s3"

# Serial flasher config
CONFIG_ESPTOOLPY_FLASHSIZE_16MB=y
CONFIG_ESPTOOLPY_FLASHMODE_QIO=y
CONFIG_ESPTOOLPY_FLASHFREQ_80M=y

# Partition Table
CONFIG_PARTITION_TABLE_CUSTOM=y
CONFIG_PARTITION_TABLE_CUSTOM_FILENAME="partitions.csv"

# ESP32S3-Specific
CONFIG_ESP32S3_DEFAULT_CPU_FREQ_240=y

# PSRAM Configuration
CONFIG_SPIRAM=y
CONFIG_SPIRAM_MODE_OCT=y
CONFIG_SPIRAM_SPEED_80M=y
CONFIG_SPIRAM_USE_MALLOC=y

# USB Configuration (USB-CDC for console)
CONFIG_ESP_CONSOLE_USB_CDC=y
CONFIG_ESP_CONSOLE_USB_CDC_SUPPORT_ETS_PRINTF=y

# Ethernet Configuration
CONFIG_ETH_ENABLED=y
CONFIG_ETH_USE_ESP32_EMAC=y
CONFIG_ETH_PHY_INTERFACE_RMII=y
CONFIG_ETH_RMII_CLK_INPUT=y
CONFIG_ETH_RMII_CLK_IN_GPIO=0

# LAN8710A PHY
CONFIG_ETH_PHY_LAN87XX=y
CONFIG_ETH_PHY_RST_GPIO=-1

# FreeRTOS
CONFIG_FREERTOS_HZ=1000
CONFIG_FREERTOS_UNICORE=n

# Logging
CONFIG_LOG_DEFAULT_LEVEL_INFO=y
CONFIG_LOG_MAXIMUM_LEVEL_VERBOSE=y

# LWIP (Networking)
CONFIG_LWIP_LOCAL_HOSTNAME="mpair"
CONFIG_LWIP_NETIF_LOOPBACK=y

# HTTP Server
CONFIG_HTTPD_MAX_REQ_HDR_LEN=1024
CONFIG_HTTPD_MAX_URI_LEN=512

# MQTT
CONFIG_MQTT_PROTOCOL_311=y

# NVS
CONFIG_NVS_ENCRYPTION=n
```
